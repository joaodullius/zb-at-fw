## CMakeLists.txt
```
#
# Telegesis R309-compatible AT firmware for the nRF54L15 DK.
#

cmake_minimum_required(VERSION 3.20.0)

find_package(Zephyr REQUIRED HINTS $ENV{ZEPHYR_BASE})

project(zb_at_fw)

target_sources(app PRIVATE
  src/main.c
  src/at_uart.c
  src/at_fmt.c
  src/at_cmd.c
  src/sreg.c
  src/zb_core.c
  src/zb_secpol.c
  src/zb_msg.c
  src/zboss_mem_globals.c
)

# zb_secpol.c changes the ZBOSS security policy and keys, which only the internal
# ZBOSS headers expose (the add-on builds lib/zboss/src with them too).
set_source_files_properties(src/zb_secpol.c PROPERTIES
  INCLUDE_DIRECTORIES ${ZEPHYR_NCS_ZIGBEE_MODULE_DIR}/lib/zboss/src/include
)

# Keep the ZBOSS memory globals out of LTO (see the NCS Zigbee coordinator sample).
if(CONFIG_LTO)
  set_source_files_properties(
    src/zboss_mem_globals.c
    PROPERTIES COMPILE_OPTIONS -fno-lto
  )
endif()
```

## sysbuild.conf
```
# Disable partition manager (the Zigbee add-on provides the partition layout).
SB_CONFIG_PARTITION_MANAGER=n
```

## prj.conf
```kconfig
CONFIG_NCS_SAMPLES_DEFAULTS=y

CONFIG_SERIAL=y
# Asynchronous (EasyDMA) UART, as in the nRF Serial Modem.
CONFIG_UART_ASYNC_API=y
CONFIG_UART_INTERRUPT_DRIVEN=n
CONFIG_RING_BUFFER=y

# The UART carries AT traffic only: no console, logs over RTT.
CONFIG_CONSOLE=n
CONFIG_UART_CONSOLE=n
CONFIG_BOOT_BANNER=n
CONFIG_LOG=y
CONFIG_LOG_MODE_DEFERRED=y
CONFIG_LOG_BACKEND_UART=n
CONFIG_USE_SEGGER_RTT=y
CONFIG_LOG_BACKEND_RTT=y

CONFIG_HEAP_MEM_POOL_SIZE=2048
CONFIG_MAIN_THREAD_PRIORITY=7
CONFIG_MAIN_STACK_SIZE=2048
CONFIG_SYSTEM_WORKQUEUE_STACK_SIZE=2048
CONFIG_REBOOT=y

# S-registers and network state are kept with the settings subsystem.
CONFIG_FLASH=y
CONFIG_FLASH_MAP=y
CONFIG_ZMS=y
CONFIG_SETTINGS=y
CONFIG_SETTINGS_ZMS=y

# Full ZBOSS library: coordinator and router, switchable to end device at runtime.
CONFIG_ZIGBEE_ADD_ON=y
CONFIG_ZIGBEE_APP_UTILS=y
CONFIG_ZIGBEE_ROLE_ROUTER=y
CONFIG_ZIGBEE_CHANNEL_SELECTION_MODE_MULTI=y
```

## boards/nrf54l15dk_nrf54l15_cpuapp.overlay
```dts
#include <nrf54l15_cpuapp_partitions.dtsi>

/ {
	chosen {
		ncs,zigbee-timer = &timer20;
	};
};

&timer20 {
	status = "okay";
};

/* AT interface: 115200 8N1 on the console UART (DK VCOM). */
&uart20 {
	current-speed = <115200>;
};
```

## src/main.c
```c
/*
 * Telegesis R309-compatible AT firmware for the nRF54L15 DK.
 *
 * One image for all Zigbee roles: the host decides over the AT interface
 * whether the node forms a network (AT+EN) or joins one as router or end
 * device (S0A bits F-E, AT+JN).
 */
#include <zephyr/kernel.h>
#include <zephyr/logging/log.h>
#include <zephyr/settings/settings.h>

#include "at.h"
#include "sreg.h"
#include "zb_core.h"
#include "zb_msg.h"

LOG_MODULE_REGISTER(main, LOG_LEVEL_INF);

int main(void)
{
	int err = at_uart_init();

	if (err) {
		LOG_ERR("AT UART not ready (%d)", err);
		return 0;
	}
	err = settings_subsys_init();
	if (err) {
		LOG_ERR("Settings init failed (%d)", err);
	}
	sreg_init();
	zbm_init();
	at_cmd_start();
	zbc_init();
	LOG_INF("AT firmware %s ready", AT_FW_REVISION);
	return 0;
}
```

## src/at.h
```c
/*
 * Shared definitions of the AT firmware (Telegesis R309 command set).
 */
#ifndef AT_H_
#define AT_H_

#include <stdbool.h>
#include <stddef.h>
#include <stdint.h>
#include <zephyr/kernel.h>

#define AT_DEVICE_NAME "nRF54L15"
#define AT_FW_REVISION "R309N"

#define AT_LINE_MAX 200

/* Handler results: AT_OK prints OK, a positive value prints ERROR:XX,
 * AT_NO_RESPONSE prints nothing (the handler printed or is rebooting).
 */
#define AT_OK          0
#define AT_NO_RESPONSE (-1)

/* Error codes, R309 AT command manual section 3. */
#define AT_ERR_UNKNOWN_CMD    0x02
#define AT_ERR_INVALID_SREG   0x04
#define AT_ERR_INVALID_PARAM  0x05
#define AT_ERR_UNREACHABLE    0x06
#define AT_ERR_NO_BUFFERS     0x18
#define AT_ERR_READ_ONLY      0x19
#define AT_ERR_BAD_PASSWORD   0x20
#define AT_ERR_CANNOT_FORM    0x25
#define AT_ERR_NO_NETWORK     0x27
#define AT_ERR_IN_PAN         0x28
#define AT_ERR_LEAVE          0x2C
#define AT_ERR_XCASTB_TIMEOUT 0x35
#define AT_ERR_TOO_MANY_UCAST 0x72
#define AT_ERR_MSG_TOO_LONG   0x74
#define AT_ERR_NOT_JOINED     0x93
#define AT_ERR_CANNOT_JOIN    0x94

struct at_cmd {
	const char *name; /* text after "AT", e.g. "I", "+JN", "&F" */
	int (*handler)(char *args); /* args: text after the name, e.g. ":0000=hi" or "?" */
};

/* at_uart.c */
int at_uart_init(void);
int at_uart_get_line(char *out, k_timeout_t timeout);
void at_uart_inject_line(const char *line);
void at_uart_set_echo(bool on);
int at_uart_read_binary(uint8_t *buf, size_t len, k_timeout_t timeout);
void at_print(const char *fmt, ...);
void at_print_parts(const char *head, const uint8_t *body, size_t body_len, const char *tail);

/* at_cmd.c */
void at_cmd_start(void);
const char *at_cmd_current_line(void);
void at_print_result(int result);
void at_reboot(void);

/* at_fmt.c */
void at_hex_rev(char *out, const uint8_t *lsb_first, size_t n);
int at_parse_hex_rev(const char *s, uint8_t *lsb_first, size_t n);
int at_parse_hex_n(const char *s, size_t len, uint32_t *out);
void at_reverse(uint8_t *buf, size_t n);

#endif /* AT_H_ */
```

## src/at_cmd.c
```c
/*
 * AT command parser and dispatcher, plus the module control commands
 * AT, ATI and ATZ.
 */
#include <ctype.h>
#include <string.h>
#include <strings.h>
#include <zephyr/kernel.h>
#include <zephyr/logging/log.h>
#include <zephyr/sys/reboot.h>
#include <zephyr/sys/util.h>

#include "at.h"
#include "sreg.h"
#include "zb_core.h"
#include "zb_msg.h"

LOG_MODULE_REGISTER(at_cmd, LOG_LEVEL_INF);

#define AT_CMD_STACK_SIZE 4096
#define AT_CMD_PRIORITY   7

static char current_line[AT_LINE_MAX];

void at_reboot(void)
{
	k_msleep(20); /* let the last line leave the UART */
	sys_reboot(SYS_REBOOT_COLD);
}

void at_print_result(int result)
{
	/* S0E bit 1 hides OK, bit 0 hides ERROR:XX. */
	if (result == AT_OK && !sreg_bit(0x0E, 1)) {
		at_print("OK");
	} else if (result > 0 && !sreg_bit(0x0E, 0)) {
		at_print("ERROR:%02X", result);
	}
}

const char *at_cmd_current_line(void)
{
	return current_line;
}

static int cmd_at(char *args)
{
	return *args ? AT_ERR_UNKNOWN_CMD : AT_OK;
}

static int cmd_ati(char *args)
{
	char eui[17];

	if (*args) {
		return AT_ERR_INVALID_PARAM;
	}
	zbc_eui64_str(eui);
	at_print("Telegesis %s", AT_DEVICE_NAME);
	at_print("%s", AT_FW_REVISION);
	at_print("%s", eui);
	return AT_OK;
}

static int cmd_atz(char *args)
{
	if (*args) {
		return AT_ERR_INVALID_PARAM;
	}
	at_print_result(AT_OK);
	at_reboot();
	return AT_NO_RESPONSE;
}

static const struct at_cmd base_cmds[] = {
	{ "", cmd_at },
	{ "I", cmd_ati },
	{ "Z", cmd_atz },
	{ "+TOKDUMP", sreg_cmd_tokdump },
	{ NULL, NULL },
};

static const struct at_cmd *const cmd_tables[] = {
	base_cmds,
	zbc_cmds,
	zbm_cmds,
	NULL,
};

static int execute(char *line)
{
	char *p;
	size_t n;

	if (line[0] == '\x01') {
		return AT_ERR_MSG_TOO_LONG;
	}
	if (toupper((unsigned char)line[0]) != 'A' || toupper((unsigned char)line[1]) != 'T') {
		return AT_ERR_UNKNOWN_CMD;
	}
	p = line + 2;
	if (toupper((unsigned char)p[0]) == 'S' && isxdigit((unsigned char)p[1])) {
		return sreg_at_command(p + 1);
	}
	n = strcspn(p, ":=?");
	for (size_t t = 0; cmd_tables[t] != NULL; t++) {
		for (const struct at_cmd *c = cmd_tables[t]; c->name != NULL; c++) {
			if (strlen(c->name) == n && strncasecmp(c->name, p, n) == 0) {
				return c->handler(p + n);
			}
		}
	}
	return AT_ERR_UNKNOWN_CMD;
}

static void at_cmd_thread(void *a, void *b, void *c)
{
	ARG_UNUSED(a);
	ARG_UNUSED(b);
	ARG_UNUSED(c);

	for (;;) {
		(void)at_uart_get_line(current_line, K_FOREVER);
		LOG_DBG("cmd: %s", current_line);
		at_print_result(execute(current_line));
	}
}

K_THREAD_DEFINE(at_cmd_tid, AT_CMD_STACK_SIZE, at_cmd_thread, NULL, NULL, NULL, AT_CMD_PRIORITY,
		0, SYS_FOREVER_MS);

void at_cmd_start(void)
{
	k_thread_start(at_cmd_tid);
}
```

## src/at_fmt.c
```c
/*
 * Hex helpers. ZBOSS keeps EUI64 / extended PAN IDs least significant byte
 * first; the AT interface shows them most significant digit first.
 */
#include <ctype.h>
#include <errno.h>
#include <stdio.h>
#include <string.h>

#include "at.h"

static int hex_nibble(char c)
{
	if (c >= '0' && c <= '9') {
		return c - '0';
	}
	c = (char)toupper((unsigned char)c);
	if (c >= 'A' && c <= 'F') {
		return c - 'A' + 10;
	}
	return -1;
}

void at_hex_rev(char *out, const uint8_t *lsb_first, size_t n)
{
	for (size_t i = 0; i < n; i++) {
		sprintf(out + 2 * i, "%02X", lsb_first[n - 1 - i]);
	}
	out[2 * n] = '\0';
}

int at_parse_hex_rev(const char *s, uint8_t *lsb_first, size_t n)
{
	for (size_t i = 0; i < n; i++) {
		int hi = hex_nibble(s[2 * i]);
		int lo = hex_nibble(s[2 * i + 1]);

		if (hi < 0 || lo < 0) {
			return -EINVAL;
		}
		lsb_first[n - 1 - i] = (uint8_t)(hi << 4 | lo);
	}
	return 0;
}

int at_parse_hex_n(const char *s, size_t len, uint32_t *out)
{
	uint32_t v = 0;

	if (len == 0 || len > 8) {
		return -EINVAL;
	}
	for (size_t i = 0; i < len; i++) {
		int d = hex_nibble(s[i]);

		if (d < 0) {
			return -EINVAL;
		}
		v = v << 4 | (uint32_t)d;
	}
	*out = v;
	return 0;
}

void at_reverse(uint8_t *buf, size_t n)
{
	for (size_t i = 0; i < n / 2; i++) {
		uint8_t t = buf[i];

		buf[i] = buf[n - 1 - i];
		buf[n - 1 - i] = t;
	}
}
```

## src/at_uart.c
```c
/*
 * AT UART on the asynchronous (EasyDMA) UART API, modelled on the UART
 * handler of the nRF Serial Modem:
 *
 * - RX: the driver fills buffers from a slab; each UART_RX_RDY is queued by
 *   reference (the buffer is reference counted) and processed in a thread:
 *   echo, line assembly, binary entry for AT+SENDUCASTB. If RX stops (no
 *   free buffer), the thread enables it again.
 * - TX: output is written to a ring buffer that uart_tx() drains, chained on
 *   UART_TX_DONE. Writers hold a mutex for a whole line, so prompts from the
 *   Zigbee thread never interleave with command responses.
 */
#include <stdarg.h>
#include <stdio.h>
#include <string.h>
#include <zephyr/device.h>
#include <zephyr/drivers/uart.h>
#include <zephyr/kernel.h>
#include <zephyr/logging/log.h>
#include <zephyr/sys/ring_buffer.h>

#include "at.h"

LOG_MODULE_REGISTER(at_uart, LOG_LEVEL_INF);

#define RX_BUF_SIZE     256
#define RX_BUF_COUNT    3
#define RX_TIMEOUT_US   2000
#define RX_EVENT_COUNT  8
#define RX_RETRY_DELAY  K_MSEC(10)
#define TX_BUF_SIZE     1024
#define AT_OUT_MAX      256
#define LINE_Q_DEPTH    8
#define RX_STACK_SIZE   2048
#define RX_PRIORITY     6

static const struct device *const uart = DEVICE_DT_GET(DT_CHOSEN(zephyr_console));

/* ---------------------------------------------------------------------------
 * RX buffers: fixed-size slab blocks with a reference count, because the
 * driver reports received data as offsets into the block it is filling.
 */
struct rx_buf {
	atomic_t refs;
	uint8_t data[RX_BUF_SIZE];
};

BUILD_ASSERT((sizeof(struct rx_buf) % 4) == 0);
K_MEM_SLAB_DEFINE_STATIC(rx_slab, sizeof(struct rx_buf), RX_BUF_COUNT, 4);

struct rx_event {
	uint8_t *data;
	size_t len;
};

K_MSGQ_DEFINE(rx_events, sizeof(struct rx_event), RX_EVENT_COUNT, 4);

/* Set by UART_RX_DISABLED (e.g. no free buffer); the RX thread enables RX again. */
static atomic_t rx_disabled;

static struct rx_buf *rx_block(const uint8_t *p)
{
	size_t n = (p - (const uint8_t *)rx_slab.buffer) / sizeof(struct rx_buf);

	return (struct rx_buf *)&rx_slab.buffer[n * sizeof(struct rx_buf)];
}

static uint8_t *rx_buf_alloc(void)
{
	struct rx_buf *b;

	if (k_mem_slab_alloc(&rx_slab, (void **)&b, K_NO_WAIT) != 0) {
		return NULL;
	}
	atomic_set(&b->refs, 1);
	return b->data;
}

static void rx_buf_ref(const uint8_t *p)
{
	atomic_inc(&rx_block(p)->refs);
}

static void rx_buf_unref(const uint8_t *p)
{
	struct rx_buf *b = rx_block(p);

	if (atomic_dec(&b->refs) == 1) {
		k_mem_slab_free(&rx_slab, b);
	}
}

static int rx_enable(void)
{
	uint8_t *buf = rx_buf_alloc();
	int err;

	if (!buf) {
		return -ENOMEM;
	}
	err = uart_rx_enable(uart, buf, RX_BUF_SIZE, RX_TIMEOUT_US);
	if (err) {
		rx_buf_unref(buf);
	}
	return err;
}

/* ---------------------------------------------------------------------------
 * TX ring buffer. tx_idle is 1 while no DMA transfer is running.
 */
RING_BUF_DECLARE(tx_ring, TX_BUF_SIZE);
K_MUTEX_DEFINE(tx_lock);
K_SEM_DEFINE(tx_idle, 1, 1);

/* Start a transfer of what is in the ring. Called with tx_idle taken. */
static void tx_start(void)
{
	uint8_t *p;
	uint32_t n = ring_buf_get_claim(&tx_ring, &p, TX_BUF_SIZE);

	if (n == 0 || uart_tx(uart, p, n, SYS_FOREVER_US) != 0) {
		ring_buf_get_finish(&tx_ring, 0);
		k_sem_give(&tx_idle);
	}
}

/* Copy into the ring, starting transfers while it is full. tx_lock held. */
static void tx_write(const void *data, size_t len)
{
	const uint8_t *p = data;

	while (len > 0) {
		uint32_t n = ring_buf_put(&tx_ring, p, len);

		p += n;
		len -= n;
		if (len > 0) {
			(void)k_sem_take(&tx_idle, K_FOREVER);
			tx_start();
		}
	}
}

static void tx_flush(void)
{
	if (k_sem_take(&tx_idle, K_NO_WAIT) == 0) {
		tx_start();
	}
}

/* ---------------------------------------------------------------------------
 * Driver callback (interrupt context)
 */
static void uart_cb(const struct device *dev, struct uart_event *evt, void *user_data)
{
	struct rx_event ev;
	uint8_t *buf;

	ARG_UNUSED(dev);
	ARG_UNUSED(user_data);

	switch (evt->type) {
	case UART_TX_DONE:
	case UART_TX_ABORTED:
		ring_buf_get_finish(&tx_ring, evt->data.tx.len);
		if (ring_buf_is_empty(&tx_ring)) {
			k_sem_give(&tx_idle);
		} else {
			tx_start();
		}
		break;
	case UART_RX_RDY:
		rx_buf_ref(evt->data.rx.buf);
		ev.data = &evt->data.rx.buf[evt->data.rx.offset];
		ev.len = evt->data.rx.len;
		if (k_msgq_put(&rx_events, &ev, K_NO_WAIT) != 0) {
			LOG_ERR("RX event queue full, %u bytes dropped", evt->data.rx.len);
			rx_buf_unref(evt->data.rx.buf);
		}
		break;
	case UART_RX_BUF_REQUEST:
		/* Keep room for this buffer's events; otherwise let RX stop and recover. */
		if (k_msgq_num_free_get(&rx_events) < 2) {
			break;
		}
		buf = rx_buf_alloc();
		if (buf && uart_rx_buf_rsp(uart, buf, RX_BUF_SIZE) != 0) {
			rx_buf_unref(buf);
		}
		break;
	case UART_RX_BUF_RELEASED:
		if (evt->data.rx_buf.buf) {
			rx_buf_unref(evt->data.rx_buf.buf);
		}
		break;
	case UART_RX_DISABLED:
		/* A flag, not a queued event: it must not be lost when the queue is full. */
		atomic_set(&rx_disabled, 1);
		break;
	case UART_RX_STOPPED:
		LOG_WRN("UART RX stopped (reason %d)", evt->data.rx_stop.reason);
		break;
	default:
		break;
	}
}

/* ---------------------------------------------------------------------------
 * RX processing (thread): echo, lines, binary entry
 */
K_MSGQ_DEFINE(line_q, AT_LINE_MAX, LINE_Q_DEPTH, 4);
K_SEM_DEFINE(bin_done, 0, 1);

/* Queued instead of a line that did not fit (a full AT_LINE_MAX message is copied). */
static const char line_overflow[AT_LINE_MAX] = "\x01";

static char rx_line[AT_LINE_MAX];
static size_t rx_len;
static bool rx_overflow;
static bool echo_on = true;

static struct k_spinlock bin_lock;
static uint8_t *bin_buf;
static size_t bin_need;
static size_t bin_have;

/* Returns true if the byte went to a pending binary entry. */
static bool bin_byte(uint8_t c)
{
	k_spinlock_key_t key = k_spin_lock(&bin_lock);
	bool taken = bin_have < bin_need;

	if (taken) {
		bin_buf[bin_have++] = c;
		if (bin_have == bin_need) {
			bin_need = 0;
			k_sem_give(&bin_done);
		}
	}
	k_spin_unlock(&bin_lock, key);
	return taken;
}

static void line_byte(uint8_t c)
{
	switch (c) {
	case '\r':
		if (rx_overflow) {
			(void)k_msgq_put(&line_q, line_overflow, K_NO_WAIT);
		} else if (rx_len > 0) {
			rx_line[rx_len] = '\0';
			if (k_msgq_put(&line_q, rx_line, K_NO_WAIT) != 0) {
				LOG_WRN("Command queue full, line dropped");
			}
		}
		rx_len = 0;
		rx_overflow = false;
		break;
	case '\n':
		break;
	case '\b':
	case 0x7F:
		if (rx_len > 0) {
			rx_len--;
		}
		break;
	default:
		if (rx_len < AT_LINE_MAX - 1) {
			rx_line[rx_len++] = c;
		} else {
			rx_overflow = true;
		}
		break;
	}
}

static void rx_process(const uint8_t *data, size_t len)
{
	uint8_t echo[RX_BUF_SIZE];
	size_t n_echo = 0;

	for (size_t i = 0; i < len; i++) {
		if (bin_byte(data[i])) {
			continue; /* binary data is not echoed */
		}
		if (echo_on && n_echo < sizeof(echo)) {
			echo[n_echo++] = data[i];
		}
		line_byte(data[i]);
	}
	if (n_echo > 0) {
		k_mutex_lock(&tx_lock, K_FOREVER);
		tx_write(echo, n_echo);
		tx_flush();
		k_mutex_unlock(&tx_lock);
	}
}

static void rx_thread(void *a, void *b, void *c)
{
	struct rx_event ev;

	ARG_UNUSED(a);
	ARG_UNUSED(b);
	ARG_UNUSED(c);

	for (;;) {
		if (k_msgq_get(&rx_events, &ev, RX_RETRY_DELAY) == 0) {
			rx_process(ev.data, ev.len);
			rx_buf_unref(ev.data);
		}
		/* Once everything received is processed (buffers are free again), restart RX. */
		if (atomic_get(&rx_disabled) && k_msgq_num_used_get(&rx_events) == 0 &&
		    rx_enable() == 0) {
			atomic_set(&rx_disabled, 0);
		}
	}
}

K_THREAD_DEFINE(at_rx_tid, RX_STACK_SIZE, rx_thread, NULL, NULL, NULL, RX_PRIORITY, 0,
		SYS_FOREVER_MS);

/* ---------------------------------------------------------------------------
 * API
 */
int at_uart_init(void)
{
	int err;

	if (!device_is_ready(uart)) {
		return -ENODEV;
	}
	err = uart_callback_set(uart, uart_cb, NULL);
	if (err) {
		return err;
	}
	k_thread_start(at_rx_tid);
	return rx_enable();
}

int at_uart_get_line(char *out, k_timeout_t timeout)
{
	return k_msgq_get(&line_q, out, timeout);
}

void at_uart_inject_line(const char *line)
{
	char buf[AT_LINE_MAX];

	strncpy(buf, line, sizeof(buf) - 1);
	buf[sizeof(buf) - 1] = '\0';
	(void)k_msgq_put(&line_q, buf, K_NO_WAIT);
}

void at_uart_set_echo(bool on)
{
	echo_on = on;
}

int at_uart_read_binary(uint8_t *buf, size_t len, k_timeout_t timeout)
{
	k_spinlock_key_t key;

	k_sem_reset(&bin_done);
	key = k_spin_lock(&bin_lock);
	bin_buf = buf;
	bin_have = 0;
	bin_need = len;
	k_spin_unlock(&bin_lock, key);

	k_mutex_lock(&tx_lock, K_FOREVER);
	tx_write("\r\n>", 3);
	tx_flush();
	k_mutex_unlock(&tx_lock);

	if (k_sem_take(&bin_done, timeout) != 0) {
		key = k_spin_lock(&bin_lock);
		bin_need = 0;
		bin_have = 0;
		k_spin_unlock(&bin_lock, key);
		return -ETIMEDOUT;
	}
	return 0;
}

void at_print_parts(const char *head, const uint8_t *body, size_t body_len, const char *tail)
{
	k_mutex_lock(&tx_lock, K_FOREVER);
	tx_write("\r\n", 2);
	if (head) {
		tx_write(head, strlen(head));
	}
	if (body) {
		tx_write(body, body_len);
	}
	if (tail) {
		tx_write(tail, strlen(tail));
	}
	tx_write("\r\n", 2);
	tx_flush();
	k_mutex_unlock(&tx_lock);
}

void at_print(const char *fmt, ...)
{
	char line[AT_OUT_MAX];
	va_list ap;

	va_start(ap, fmt);
	vsnprintf(line, sizeof(line), fmt, ap);
	va_end(ap);
	at_print_parts(line, NULL, 0, NULL);
}
```

## src/sreg.c
```c
/*
 * S-registers of the R309 command set: table, validation, ATS commands and
 * persistence (settings keys "at/s/<XX>").
 */
#include <ctype.h>
#include <errno.h>
#include <stdio.h>
#include <stdlib.h>
#include <string.h>
#include <zephyr/kernel.h>
#include <zephyr/logging/log.h>
#include <zephyr/settings/settings.h>
#include <zephyr/sys/util.h>

#include "at.h"
#include "sreg.h"

LOG_MODULE_REGISTER(sreg, LOG_LEVEL_INF);

enum sreg_type {
	T_U8,       /* 2 hex digits */
	T_U16,      /* 4 hex digits */
	T_S8,       /* signed decimal, S01 */
	T_HEX64,    /* 16 hex digits */
	T_KEY128,   /* 32 hex digits */
	T_STR,      /* text up to max_len */
	T_CLUSTERS, /* up to 8 comma-separated 16-bit IDs */
	T_DYN,      /* value comes from sreg_dynamic_read() */
};

#define F_NV BIT(0) /* persisted */
#define F_RO BIT(1) /* read only */
#define F_PW BIT(2) /* write needs the password */
#define F_WO BIT(3) /* write only: reads show an empty value */

#define VAL_MAX 48

struct sreg {
	uint16_t id;
	uint8_t type;
	uint8_t flags;
	uint8_t max_len;
	const char *def;
	char val[VAL_MAX];
};

static struct sreg regs[] = {
	{ 0x00, T_U16, F_NV, 0, "FFFF" },   /* channel mask, bit 0 = channel 11 */
	{ 0x01, T_S8, F_NV, 0, "07" },      /* TX power [dBm]: 7 = max of the nRF54L15 QFN, 8 for CSP */
	{ 0x02, T_U16, F_NV, 0, "0000" },   /* preferred PAN ID */
	{ 0x03, T_HEX64, F_NV, 0, "0000000000000000" }, /* preferred EPID */
	{ 0x04, T_DYN, F_RO, 0, "" },       /* local EUI64 */
	{ 0x05, T_DYN, F_RO, 0, "" },       /* local NWK address */
	{ 0x08, T_KEY128, F_NV | F_PW | F_WO, 0, "00000000000000000000000000000000" },
	{ 0x09, T_KEY128, F_NV | F_PW | F_WO, 0, "5A6967426565416C6C69616E63653039" },
	{ 0x0A, T_U16, F_NV | F_PW, 0, "0000" }, /* main function */
	{ 0x0B, T_STR, F_NV, 16, "" },      /* user readable name */
	{ 0x0C, T_STR, F_NV | F_PW | F_WO, 8, "password" },
	{ 0x0D, T_DYN, F_RO, 0, "" },       /* device information */
	{ 0x0E, T_U16, F_NV, 0, "0000" },   /* prompt enable 1 */
	{ 0x0F, T_U16, F_NV, 0, "0006" },   /* prompt enable 2 */
	{ 0x10, T_U16, F_NV, 0, "0000" },   /* extended function */
	{ 0x12, T_U16, F_NV, 0, "0C00" },   /* UART: 115200, echo on */
	{ 0x40, T_U16, 0, 0, "0101" },      /* xCAST src/dst endpoints (volatile) */
	{ 0x41, T_U16, F_NV, 0, "0101" },
	{ 0x42, T_U16, 0, 0, "0002" },      /* xCAST cluster (volatile) */
	{ 0x43, T_U16, F_NV, 0, "0002" },
	{ 0x44, T_U16, 0, 0, "C091" },      /* xCAST profile (volatile) */
	{ 0x45, T_U16, F_NV, 0, "C091" },
	{ 0x48, T_U16, F_NV, 0, "C091" },   /* endpoint 2 profile */
	{ 0x49, T_U16, F_NV, 0, "0000" },   /* endpoint 2 device ID */
	{ 0x4A, T_U8, F_NV, 0, "00" },      /* endpoint 2 device version */
	{ 0x4B, T_CLUSTERS, F_NV, 0, "" },  /* endpoint 2 input clusters */
	{ 0x4C, T_CLUSTERS, F_NV, 0, "" },  /* endpoint 2 output clusters */
	{ 0x4E, T_U16, F_NV, 0, "0000" },   /* end device poll timeout (stored only) */
};

__weak void sreg_written(uint16_t id)
{
	ARG_UNUSED(id);
}

__weak int sreg_dynamic_read(uint16_t id, char *out, size_t len)
{
	ARG_UNUSED(id);
	if (len > 0) {
		out[0] = '\0';
	}
	return 0;
}

static struct sreg *find(uint16_t id)
{
	for (size_t i = 0; i < ARRAY_SIZE(regs); i++) {
		if (regs[i].id == id) {
			return &regs[i];
		}
	}
	return NULL;
}

static void key_of(const struct sreg *r, char *key, size_t len)
{
	snprintf(key, len, "at/s/%02X", r->id);
}

static void persist(const struct sreg *r)
{
	char key[12];

	if (r->flags & F_NV) {
		key_of(r, key, sizeof(key));
		(void)settings_save_one(key, r->val, strlen(r->val) + 1);
	}
}

static bool all_hex(const char *s, size_t len)
{
	for (size_t i = 0; i < len; i++) {
		if (!isxdigit((unsigned char)s[i])) {
			return false;
		}
	}
	return true;
}

static bool numeric(const struct sreg *r)
{
	return r->type == T_U8 || r->type == T_U16;
}

/* Validate `in` for register `r` and write its canonical form to `out`. */
static int normalise(const struct sreg *r, const char *in, char *out)
{
	size_t len = strlen(in);
	uint32_t v;

	switch (r->type) {
	case T_U8:
	case T_U16: {
		size_t digits = r->type == T_U8 ? 2 : 4;

		if (len == 0 || len > digits || at_parse_hex_n(in, len, &v)) {
			return AT_ERR_INVALID_PARAM;
		}
		if (r->id == 0x12 && (v >> 8) != 0x0C) {
			return AT_ERR_INVALID_PARAM; /* only 115200 baud is supported */
		}
		sprintf(out, digits == 2 ? "%02X" : "%04X", (unsigned int)v);
		return AT_OK;
	}
	case T_S8: {
		char *end;
		long d = strtol(in, &end, 10);

		if (len == 0 || *end != '\0' || d < -40 || d > 8) {
			return AT_ERR_INVALID_PARAM;
		}
		sprintf(out, d < 0 ? "-%02ld" : "%02ld", d < 0 ? -d : d);
		return AT_OK;
	}
	case T_HEX64:
	case T_KEY128: {
		size_t digits = r->type == T_HEX64 ? 16 : 32;

		if (len != digits || !all_hex(in, len)) {
			return AT_ERR_INVALID_PARAM;
		}
		for (size_t i = 0; i <= len; i++) {
			out[i] = (char)toupper((unsigned char)in[i]);
		}
		return AT_OK;
	}
	case T_STR:
		if (len > r->max_len) {
			return AT_ERR_INVALID_PARAM;
		}
		strcpy(out, in);
		return AT_OK;
	case T_CLUSTERS: {
		size_t count = 0;
		const char *p = in;

		out[0] = '\0';
		while (*p) {
			if (count == SREG_MAX_CLUSTERS || strlen(p) < 4 || !all_hex(p, 4) ||
			    (p[4] != ',' && p[4] != '\0') || (p[4] == ',' && p[5] == '\0')) {
				return AT_ERR_INVALID_PARAM;
			}
			at_parse_hex_n(p, 4, &v);
			sprintf(out + strlen(out), count ? ",%04X" : "%04X", (unsigned int)v);
			count++;
			p += p[4] == ',' ? 5 : 4;
		}
		return AT_OK;
	}
	default:
		return AT_ERR_READ_ONLY;
	}
}

static void apply_side_effects(const struct sreg *r)
{
	if (r->id == 0x12) {
		at_uart_set_echo(!(sreg_u32(0x12) & BIT(4)));
	}
}

static int load_cb(const char *key, size_t len, settings_read_cb read_cb, void *cb_arg,
		   void *param)
{
	uint32_t id;
	struct sreg *r;
	char buf[VAL_MAX];
	ssize_t n;

	ARG_UNUSED(param);
	if (strlen(key) != 2 || at_parse_hex_n(key, 2, &id) || !(r = find((uint16_t)id)) ||
	    len > sizeof(buf)) {
		return 0;
	}
	n = read_cb(cb_arg, buf, len);
	if (n > 0) {
		buf[n - 1] = '\0';
		strcpy(r->val, buf);
	}
	return 0;
}

static void load_defaults(void)
{
	for (size_t i = 0; i < ARRAY_SIZE(regs); i++) {
		strcpy(regs[i].val, regs[i].def);
	}
}

static void init_volatile(void)
{
	/* S40, S42, S44 start from S41, S43, S45. */
	strcpy(find(0x40)->val, find(0x41)->val);
	strcpy(find(0x42)->val, find(0x43)->val);
	strcpy(find(0x44)->val, find(0x45)->val);
}

int sreg_init(void)
{
	load_defaults();
	(void)settings_load_subtree_direct("at/s", load_cb, NULL);
	init_volatile();
	apply_side_effects(find(0x12));
	return 0;
}

void sreg_factory_reset(void)
{
	char key[12];

	for (size_t i = 0; i < ARRAY_SIZE(regs); i++) {
		if (regs[i].flags & F_NV) {
			key_of(&regs[i], key, sizeof(key));
			(void)settings_delete(key);
		}
	}
	load_defaults();
	init_volatile();
}

uint32_t sreg_u32(uint16_t id)
{
	const struct sreg *r = find(id);

	return r ? (uint32_t)strtoul(r->val, NULL, 16) : 0;
}

int8_t sreg_s8(uint16_t id)
{
	const struct sreg *r = find(id);

	return r ? (int8_t)atoi(r->val) : 0;
}

bool sreg_bit(uint16_t id, uint8_t bit)
{
	return (sreg_u32(id) >> bit) & 1U;
}

int sreg_bytes(uint16_t id, uint8_t *out, size_t len)
{
	const struct sreg *r = find(id);
	uint32_t byte;

	if (!r || strlen(r->val) != 2 * len) {
		return -EINVAL;
	}
	for (size_t i = 0; i < len; i++) {
		at_parse_hex_n(&r->val[2 * i], 2, &byte);
		out[i] = (uint8_t)byte;
	}
	return 0;
}

bool sreg_is_zero(uint16_t id)
{
	const struct sreg *r = find(id);

	for (const char *p = r ? r->val : ""; *p; p++) {
		if (*p != '0') {
			return false;
		}
	}
	return true;
}

int sreg_clusters(uint16_t id, uint16_t *out, size_t max)
{
	const struct sreg *r = find(id);
	const char *p = r ? r->val : "";
	size_t n = 0;
	uint32_t v;

	while (*p && n < max && at_parse_hex_n(p, 4, &v) == 0) {
		out[n++] = (uint16_t)v;
		p += p[4] == ',' ? 5 : 4;
	}
	return (int)n;
}

static int read_reg(const struct sreg *r, int bit)
{
	char val[VAL_MAX];

	if (r->type == T_DYN) {
		(void)sreg_dynamic_read(r->id, val, sizeof(val));
	} else if (r->flags & F_WO) {
		val[0] = '\0';
	} else {
		strcpy(val, r->val);
	}

	if (bit >= 0) {
		if (!numeric(r)) {
			return AT_ERR_INVALID_PARAM;
		}
		at_print("%u", (unsigned int)((strtoul(val, NULL, 16) >> bit) & 1U));
	} else {
		at_print("%s", val);
	}
	return AT_OK;
}

static int write_reg(struct sreg *r, int bit, char *arg)
{
	char *sep = strchr(arg, ':'); /* the minimal libc has no strpbrk() */
	char value[VAL_MAX];
	int err;

	if (r->flags & F_RO) {
		return AT_ERR_READ_ONLY;
	}
	if (!sep) {
		sep = strchr(arg, ';');
	}
	if (sep) {
		*sep = '\0';
	}
	if ((r->flags & F_PW) && (!sep || strcmp(sep + 1, find(0x0C)->val) != 0)) {
		return AT_ERR_BAD_PASSWORD;
	}

	if (bit >= 0) {
		uint32_t v = (uint32_t)strtoul(r->val, NULL, 16);

		if (!numeric(r) || (strcmp(arg, "0") != 0 && strcmp(arg, "1") != 0)) {
			return AT_ERR_INVALID_PARAM;
		}
		v = arg[0] == '1' ? (v | BIT(bit)) : (v & ~BIT(bit));
		snprintf(value, sizeof(value), r->type == T_U8 ? "%02X" : "%04X", (unsigned int)v);
		arg = value;
	}

	err = normalise(r, arg, value);
	if (err) {
		return err;
	}
	strcpy(r->val, value);
	persist(r);
	apply_side_effects(r);
	sreg_written(r->id);
	return AT_OK;
}

int sreg_at_command(char *arg)
{
	size_t n = 0;
	uint32_t id;
	uint32_t bit;
	struct sreg *r;

	while (isxdigit((unsigned char)arg[n])) {
		n++;
	}
	if ((n != 2 && n != 3) || at_parse_hex_n(arg, 2, &id) || !(r = find((uint16_t)id))) {
		return AT_ERR_INVALID_SREG;
	}
	if (n == 3) {
		at_parse_hex_n(&arg[2], 1, &bit);
	}
	if (arg[n] == '?' && arg[n + 1] == '\0') {
		return read_reg(r, n == 3 ? (int)bit : -1);
	}
	if (arg[n] == '=') {
		return write_reg(r, n == 3 ? (int)bit : -1, &arg[n + 1]);
	}
	return AT_ERR_INVALID_PARAM;
}

int sreg_cmd_tokdump(char *args)
{
	char val[VAL_MAX];

	if (*args) {
		return AT_ERR_INVALID_PARAM;
	}
	for (size_t i = 0; i < ARRAY_SIZE(regs); i++) {
		const struct sreg *r = &regs[i];

		if (r->type == T_DYN) {
			(void)sreg_dynamic_read(r->id, val, sizeof(val));
		} else {
			strcpy(val, (r->flags & F_WO) ? "" : r->val);
		}
		at_print("S%02X:%s", r->id, val);
	}
	return AT_OK;
}
```

## src/sreg.h
```c
#ifndef SREG_H_
#define SREG_H_

#include <stdbool.h>
#include <stddef.h>
#include <stdint.h>

#define SREG_MAX_CLUSTERS 8

int sreg_init(void);
uint32_t sreg_u32(uint16_t id);
int8_t sreg_s8(uint16_t id);
bool sreg_bit(uint16_t id, uint8_t bit);
/* Hex registers (S03, S08, S09) as bytes in the order written (MSB first). */
int sreg_bytes(uint16_t id, uint8_t *out, size_t len);
bool sreg_is_zero(uint16_t id);
int sreg_clusters(uint16_t id, uint16_t *out, size_t max);
void sreg_factory_reset(void);

/* AT handlers: sreg_at_command() gets the text after "ATS". */
int sreg_at_command(char *arg);
int sreg_cmd_tokdump(char *args);

/* Called after a register was written (weak default in sreg.c does nothing). */
void sreg_written(uint16_t id);

/* Read-only registers owned by the Zigbee glue (S04, S05, S0D). Weak default in sreg.c. */
int sreg_dynamic_read(uint16_t id, char *out, size_t len);

#endif /* SREG_H_ */
```

## src/zb_core.c
```c
/*
 * Zigbee stack control for the AT firmware: role selection, start, leave,
 * network prompts, and the AT commands that drive them.
 *
 * ZBOSS can be started once per boot and its role is fixed before start.
 * So: the stack starts on AT+EN / AT+JN / AT+JPAN (after erasing ZBOSS NVRAM),
 * or at boot when a network was recorded ("at/zb/role"). A second attempt in
 * the same boot is stored in "at/zb/pend" and run right after a silent reboot.
 */
#include <stdio.h>
#include <stdlib.h>
#include <string.h>
#include <zephyr/kernel.h>
#include <zephyr/logging/log.h>
#include <zephyr/settings/settings.h>

#include <zboss_api.h>
#include <zb_address.h>
#include <zb_nrf_platform.h>
#include <zigbee/zigbee_app_utils.h>
#include <zigbee/zigbee_error_handler.h>

#include "at.h"
#include "sreg.h"
#include "zb_core.h"

LOG_MODULE_REGISTER(zb_core, LOG_LEVEL_INF);

#define FORM_TIMEOUT          K_SECONDS(20)
#define JOIN_TIMEOUT          K_SECONDS(30)
#define LEAVE_TIMEOUT         K_SECONDS(5)
#define PERMIT_JOIN_REFRESH_S 150 /* steering opens the network for 180 s */

#define S0A_BLOCK_JOIN_LOCAL 0x0
#define S0A_NO_UNSECURE_REJOIN 0x3
#define S0A_ENCRYPT_NWK_KEY  0x4
#define S0A_BLOCK_JOIN_TC    0x5
#define S0A_USE_S09_KEY      0x8
#define S0A_NO_TCLK_REQUEST  0xA
#define S0A_TYPE_LOW         0xE
#define S0A_TYPE_HIGH        0xF
#define S0E_JPAN_OFF         0x3
#define S0E_LEFTPAN_OFF      0x4
#define S0E_NEWNODE_OFF      0x8
#define S0F_ANNOUNCE_OFF     0x0
#define S0F_NODELEFT_ON      0xB

#define CAP_DEVICE_TYPE_FFD BIT(1)
#define CAP_RX_ON_WHEN_IDLE BIT(3)

enum op {
	OP_NONE,
	OP_FORM,
	OP_JOIN,
	OP_LEAVE,
	OP_FACTORY,
};

static volatile enum op op;
static volatile int op_result;
static K_SEM_DEFINE(op_done, 0, 1);
static bool stack_started;
static uint8_t stored_role;
static char pending_cmd[AT_LINE_MAX];
static struct k_work_delayable reboot_work;
static zb_ieee_addr_t last_newnode;

/* ---------------------------------------------------------------------------
 * State
 */
static int load_cb(const char *key, size_t len, settings_read_cb read_cb, void *cb_arg,
		   void *param)
{
	ARG_UNUSED(param);

	if (strcmp(key, "role") == 0 && len == 1) {
		(void)read_cb(cb_arg, &stored_role, 1);
	} else if (strcmp(key, "pend") == 0 && len <= sizeof(pending_cmd)) {
		ssize_t n = read_cb(cb_arg, pending_cmd, len);

		pending_cmd[n > 0 ? n - 1 : 0] = '\0';
	}
	return 0;
}

static void role_save(uint8_t role)
{
	stored_role = role;
	(void)settings_save_one("at/zb/role", &role, sizeof(role));
}

static void reboot_fn(struct k_work *work)
{
	ARG_UNUSED(work);
	at_reboot();
}

static void complete(int result)
{
	if (op != OP_NONE) {
		op_result = result;
		op = OP_NONE;
		k_sem_give(&op_done);
	}
}

bool zbc_joined(void)
{
	return stack_started && ZB_JOINED();
}

void zbc_eui64_str(char out[17])
{
	zb_ieee_addr_t ieee;

	zb_get_long_address(ieee);
	at_hex_rev(out, ieee, sizeof(ieee));
}

int sreg_dynamic_read(uint16_t id, char *out, size_t len)
{
	switch (id) {
	case 0x04:
		if (len < 17) {
			return -ENOMEM;
		}
		zbc_eui64_str(out);
		return 0;
	case 0x05:
		snprintf(out, len, "%04X", zbc_joined() ? zb_get_short_address() : 0xFFFE);
		return 0;
	case 0x0D:
		snprintf(out, len, "%s,%s", AT_DEVICE_NAME, AT_FW_REVISION);
		return 0;
	default:
		return -ENOENT;
	}
}

/* ---------------------------------------------------------------------------
 * Prompts (ZBOSS thread)
 */
static void print_jpan(void)
{
	zb_ext_pan_id_t epid;
	char epid_str[17];

	if (sreg_bit(0x0E, S0E_JPAN_OFF)) {
		return;
	}
	zb_get_extended_pan_id(epid);
	at_hex_rev(epid_str, epid, sizeof(epid));
	at_print("JPAN:%u,%04X,%s", zb_get_current_channel(), zb_get_pan_id(), epid_str);
}

static void print_announce(const zb_zdo_signal_device_annce_params_t *p)
{
	char eui[17];
	const char *kind;

	if (sreg_bit(0x0F, S0F_ANNOUNCE_OFF)) {
		return;
	}
	if (p->capability & CAP_DEVICE_TYPE_FFD) {
		kind = "FFD";
	} else if (p->capability & CAP_RX_ON_WHEN_IDLE) {
		kind = "ZED";
	} else {
		kind = "SED";
	}
	at_hex_rev(eui, p->ieee_addr, sizeof(p->ieee_addr));
	at_print("%s:%s,%04X", kind, eui, p->device_short_addr);
}

static void print_newnode(zb_uint16_t short_addr, const zb_ieee_addr_t ieee)
{
	char eui[17];

	/* Direct children are reported twice (association and device update). */
	if (ZB_IEEE_ADDR_CMP(last_newnode, ieee)) {
		return;
	}
	ZB_IEEE_ADDR_COPY(last_newnode, ieee);
	if (sreg_bit(0x0E, S0E_NEWNODE_OFF)) {
		return;
	}
	at_hex_rev(eui, ieee, 8);
	at_print("NEWNODE:%04X,%s,FFFF", short_addr, eui);
}

static void print_nodeleft(zb_uint16_t short_addr, const zb_ieee_addr_t ieee)
{
	char eui[17];

	if (ZB_IEEE_ADDR_CMP(last_newnode, ieee)) {
		ZB_IEEE_ADDR_ZERO(last_newnode); /* report a later rejoin again */
	}
	if (!sreg_bit(0x0F, S0F_NODELEFT_ON)) {
		return;
	}
	at_hex_rev(eui, ieee, 8);
	at_print("NODELEFT:%04X,%s", short_addr, eui);
}

/* ---------------------------------------------------------------------------
 * Stack control
 */
static zb_uint32_t channel_mask(void)
{
	return (zb_uint32_t)sreg_u32(0x00) << 11; /* S00 bit 0 = channel 11 */
}

static bool end_device_type(void)
{
	return sreg_bit(0x0A, S0A_TYPE_HIGH) || sreg_bit(0x0A, S0A_TYPE_LOW);
}

static uint8_t current_role(void)
{
	switch (zb_get_network_role()) {
	case ZB_NWK_DEVICE_TYPE_COORDINATOR:
		return ZBC_ROLE_ZC;
	case ZB_NWK_DEVICE_TYPE_ROUTER:
		return ZBC_ROLE_ZR;
	default:
		return ZBC_ROLE_ZED;
	}
}

/* Keys and key transport, applied before the stack starts (they are read at join time). */
static void security_prestart(uint8_t role)
{
	static const uint8_t standard_key[16] = ZB_STANDARD_TC_KEY
	uint8_t key[16];

	/* S0A bit 8: preconfigured TC link key from S09, else the Zigbee default key. */
	if (sreg_bit(0x0A, S0A_USE_S09_KEY) && sreg_bytes(0x09, key, sizeof(key)) == 0) {
		zbc_tc_link_key_apply(key);
	} else {
		zbc_tc_link_key_apply(standard_key);
	}
	if (role == ZBC_ROLE_ZC) {
		/* S0A bit 4 clear (R309 default): the TC sends the network key without link
		 * key encryption (applied again in join_policy_apply, formation resets it).
		 */
		zbc_tc_unencrypted_key_transport(!sreg_bit(0x0A, S0A_ENCRYPT_NWK_KEY));
	} else {
		/* Like R309 (Ember) nodes, accept a network key sent in clear. */
		zbc_accept_unencrypted_key_transport(true);
	}
}

static void set_role(uint8_t role, zb_uint32_t mask)
{
	security_prestart(role);
	if (role == ZBC_ROLE_ZC) {
		zb_set_network_coordinator_role(mask);
		/* Pre-Zigbee 3.0 devices may join and are not evicted. */
		zb_bdb_set_legacy_device_support(1);
		return;
	}
	if (role == ZBC_ROLE_ZR) {
		zb_set_network_router_role(mask);
	} else {
		zb_set_network_ed_role(mask);
		zb_set_rx_on_when_idle(ZB_TRUE); /* v1: SED/MED behave as a non-sleepy ZED */
	}
	zb_bdb_set_legacy_device_support(sreg_bit(0x0A, S0A_NO_TCLK_REQUEST) ? 1 : 0);
}

static void tx_power_done(zb_bufid_t bufid)
{
	zb_tx_power_params_t *p = zb_buf_begin(bufid);

	if (p->status != RET_OK) {
		LOG_WRN("TX power not set (%d)", p->status);
	}
	zb_buf_free(bufid);
}

static void tx_power_set(zb_bufid_t bufid)
{
	zb_tx_power_params_t *p = zb_buf_initial_alloc(bufid, sizeof(*p));

	p->page = ZB_CHANNEL_PAGE0_2_4_GHZ;
	p->channel = zb_get_current_channel();
	p->tx_power = sreg_s8(0x01);
	p->cb = tx_power_done;
	zb_set_tx_power_async(bufid);
}

/* ---------------------------------------------------------------------------
 * Join control (ZBOSS thread). The coordinator keeps the whole network open by
 * re-running BDB network steering (S0A bit 5 on the TC closes it network-wide);
 * S0A bit 0 closes joining through the local node, on any node, every time the
 * network is opened again.
 */
static void permit_req_done(zb_bufid_t bufid)
{
	zb_buf_free(bufid);
}

/* tc_significance = 1 also changes the Trust Centre policy: the TC then refuses to
 * authorize any join, through any router (measured). 0 only closes the addressed node.
 */
static void permit_join_send(zb_bufid_t bufid, zb_uint16_t dest, zb_uint8_t tc_significance)
{
	zb_zdo_mgmt_permit_joining_req_param_t *req =
		ZB_BUF_GET_PARAM(bufid, zb_zdo_mgmt_permit_joining_req_param_t);

	req->dest_addr = dest;
	req->permit_duration = 0;
	req->tc_significance = tc_significance;
	if (zb_zdo_mgmt_permit_joining_req(bufid, permit_req_done) == ZB_ZDO_INVALID_TSN) {
		zb_buf_free(bufid);
	}
}

/* S0A bit 0: no joining through this node. */
static void close_local(zb_bufid_t bufid)
{
	permit_join_send(bufid, zb_get_short_address(), 0);
}

/* S0A bit 5 on the TC: the Trust Centre accepts no new node, whoever the parent is. */
static void close_network(zb_bufid_t bufid)
{
	permit_join_send(bufid, zb_get_short_address(), 1);
}

static void permit_join_refresh(zb_uint8_t param)
{
	ARG_UNUSED(param);

	if (sreg_bit(0x0A, S0A_BLOCK_JOIN_TC)) {
		return;
	}
	if (!bdb_start_top_level_commissioning(ZB_BDB_NETWORK_STEERING)) {
		ZB_SCHEDULE_APP_ALARM(permit_join_refresh, 0, ZB_TIME_ONE_SECOND * 5);
	}
}

/* Apply S0A bits 0, 3 and 5 now (after joining, or when S0A is written). */
static void join_policy_apply(zb_uint8_t param)
{
	ARG_UNUSED(param);

	if (!ZB_JOINED()) {
		return;
	}
	if (current_role() == ZBC_ROLE_ZC) {
		zbc_tc_rejoin_apply(!sreg_bit(0x0A, S0A_NO_UNSECURE_REJOIN));
		zbc_tc_unencrypted_key_transport(!sreg_bit(0x0A, S0A_ENCRYPT_NWK_KEY));
		zbc_tc_authenticate_always(sreg_bit(0x0A, S0A_BLOCK_JOIN_LOCAL));
		ZB_SCHEDULE_APP_ALARM_CANCEL(permit_join_refresh, ZB_ALARM_ANY_PARAM);
		if (sreg_bit(0x0A, S0A_BLOCK_JOIN_TC)) {
			(void)zb_buf_get_out_delayed(close_network);
			return;
		}
		/* Opens the network; the PERMIT_JOIN_STATUS signal then applies bit 0. */
		ZB_SCHEDULE_APP_CALLBACK(permit_join_refresh, 0);
	} else if (sreg_bit(0x0A, S0A_BLOCK_JOIN_LOCAL)) {
		(void)zb_buf_get_out_delayed(close_local);
	}
}

void sreg_written(uint16_t id)
{
	if (id == 0x0A && zbc_joined()) {
		ZB_SCHEDULE_APP_CALLBACK(join_policy_apply, 0);
	}
}

static void network_up(void)
{
	uint8_t role = current_role();

	if (stored_role != role) {
		role_save(role);
	}
	(void)zb_buf_get_out_delayed(tx_power_set);
	if (role == ZBC_ROLE_ZC) {
		zbc_legacy_tc_apply(true); /* R309 is a pre-Zigbee 3.0 Trust Centre */
	}
	ZB_SCHEDULE_APP_CALLBACK(join_policy_apply, 0);
	print_jpan();
}

void zboss_signal_handler(zb_bufid_t bufid)
{
	zb_zdo_app_signal_hdr_t *hdr = NULL;
	zb_zdo_app_signal_type_t sig = zb_get_app_signal(bufid, &hdr);
	zb_ret_t status = ZB_GET_APP_SIGNAL_STATUS(bufid);
	bool is_zc = zb_get_network_role() == ZB_NWK_DEVICE_TYPE_COORDINATOR;

	switch (sig) {
	case ZB_BDB_SIGNAL_DEVICE_FIRST_START:
		if (op == OP_FORM) {
			if (status != RET_OK ||
			    !bdb_start_top_level_commissioning(ZB_BDB_NETWORK_FORMATION)) {
				complete(AT_ERR_CANNOT_FORM);
			}
		} else if (op == OP_JOIN) {
			if (status != RET_OK ||
			    !bdb_start_top_level_commissioning(ZB_BDB_NETWORK_STEERING)) {
				complete(AT_ERR_CANNOT_JOIN);
			}
		} else {
			/* A network was recorded but ZBOSS NVRAM is empty. */
			role_save(ZBC_ROLE_NONE);
		}
		break;

	case ZB_BDB_SIGNAL_DEVICE_REBOOT:
		if (status == RET_OK) {
			network_up();
		} else if (!is_zc) {
			/* The default handler keeps trying to rejoin. */
			ZB_ERROR_CHECK(zigbee_default_signal_handler(bufid));
		}
		break;

	case ZB_BDB_SIGNAL_FORMATION:
		if (status == RET_OK) {
			network_up();
			complete(AT_OK);
		} else {
			complete(AT_ERR_CANNOT_FORM);
		}
		break;

	case ZB_BDB_SIGNAL_STEERING:
		if (is_zc) {
			ZB_SCHEDULE_APP_ALARM_CANCEL(permit_join_refresh, ZB_ALARM_ANY_PARAM);
			ZB_SCHEDULE_APP_ALARM(permit_join_refresh, 0,
					      ZB_TIME_ONE_SECOND *
						      (status == RET_OK ? PERMIT_JOIN_REFRESH_S : 5));
		} else if (op == OP_JOIN) {
			if (status == RET_OK && ZB_JOINED()) {
				network_up();
				complete(AT_OK);
			} else {
				complete(AT_ERR_CANNOT_JOIN);
			}
		} else if (stored_role != ZBC_ROLE_NONE) {
			/* Rejoin of the recorded network, driven by the default handler
			 * (after a reboot, a lost parent or a leave with rejoin).
			 */
			bool up = status == RET_OK && ZB_JOINED();

			ZB_ERROR_CHECK(zigbee_default_signal_handler(bufid));
			if (up) {
				network_up();
			}
		}
		/* Otherwise an AT+JN/AT+JPAN failed or timed out: no automatic retries. */
		break;

	case ZB_ZDO_SIGNAL_LEAVE: {
		zb_zdo_signal_leave_params_t *p =
			ZB_ZDO_SIGNAL_GET_PARAMS(hdr, zb_zdo_signal_leave_params_t);

		if (op == OP_JOIN) {
			/* Joined and left again, e.g. the TC link key exchange failed. */
			role_save(ZBC_ROLE_NONE);
			complete(AT_ERR_CANNOT_JOIN);
		} else if (op == OP_LEAVE || op == OP_FACTORY) {
			complete(AT_OK);
		} else if (status != RET_OK) {
			LOG_WRN("Leave failed (status %d)", status);
		} else if (p->leave_type == ZB_NWK_LEAVE_TYPE_REJOIN) {
			/* Asked to leave and rejoin: keep the network, the default handler rejoins. */
			LOG_INF("Leave with rejoin");
			ZB_ERROR_CHECK(zigbee_default_signal_handler(bufid));
		} else if (stored_role != ZBC_ROLE_NONE) {
			/* Removed from the network by another node. */
			role_save(ZBC_ROLE_NONE);
			if (!sreg_bit(0x0E, S0E_LEFTPAN_OFF)) {
				at_print("LeftPAN");
			}
			k_work_reschedule(&reboot_work, K_MSEC(200));
		}
	} break;

	case ZB_NWK_SIGNAL_PERMIT_JOIN_STATUS:
		/* The network was opened (e.g. by the coordinator's steering): S0A bit 0
		 * keeps joining through this node closed.
		 */
		if (*ZB_ZDO_SIGNAL_GET_PARAMS(hdr, zb_uint8_t) > 0 &&
		    sreg_bit(0x0A, S0A_BLOCK_JOIN_LOCAL)) {
			(void)zb_buf_get_out_delayed(close_local);
		}
		break;

	case ZB_ZDO_SIGNAL_DEVICE_ANNCE:
		print_announce(ZB_ZDO_SIGNAL_GET_PARAMS(hdr, zb_zdo_signal_device_annce_params_t));
		break;

	case ZB_NWK_SIGNAL_DEVICE_ASSOCIATED:
		if (is_zc) {
			zb_nwk_signal_device_associated_params_t *p = ZB_ZDO_SIGNAL_GET_PARAMS(
				hdr, zb_nwk_signal_device_associated_params_t);

			print_newnode(zb_address_short_by_ieee(p->device_addr), p->device_addr);
		}
		break;

	case ZB_ZDO_SIGNAL_DEVICE_UPDATE: {
		zb_zdo_signal_device_update_params_t *p =
			ZB_ZDO_SIGNAL_GET_PARAMS(hdr, zb_zdo_signal_device_update_params_t);

		if (is_zc && p->status == 0x01) { /* standard device unsecured join */
			print_newnode(p->short_addr, p->long_addr);
		} else if (is_zc && p->status == 0x02) { /* device left */
			print_nodeleft(p->short_addr, p->long_addr);
		}
		ZB_ERROR_CHECK(zigbee_default_signal_handler(bufid));
	} break;

	case ZB_ZDO_SIGNAL_LEAVE_INDICATION: {
		zb_zdo_signal_leave_indication_params_t *p =
			ZB_ZDO_SIGNAL_GET_PARAMS(hdr, zb_zdo_signal_leave_indication_params_t);

		if (is_zc && !p->rejoin) {
			print_nodeleft(p->short_addr, p->device_addr);
		}
		ZB_ERROR_CHECK(zigbee_default_signal_handler(bufid));
	} break;

	default:
		ZB_ERROR_CHECK(zigbee_default_signal_handler(bufid));
		break;
	}

	if (bufid) {
		zb_buf_free(bufid);
	}
}

/* ---------------------------------------------------------------------------
 * AT commands (AT thread)
 */
static int run_op(enum op new_op, k_timeout_t timeout, int timeout_err)
{
	k_sem_reset(&op_done);
	op = new_op;
	if (!stack_started) {
		stack_started = true;
		zigbee_enable();
	}
	if (k_sem_take(&op_done, timeout) != 0) {
		op = OP_NONE;
		return timeout_err;
	}
	return op_result;
}

static int defer_to_next_boot(void)
{
	const char *line = at_cmd_current_line();

	(void)settings_save_one("at/zb/pend", line, strlen(line) + 1);
	at_reboot();
	return AT_NO_RESPONSE;
}

static void prepare_new_network(uint8_t role, zb_uint32_t mask, const uint8_t *epid_lsb)
{
	zigbee_erase_persistent_storage(ZB_TRUE);
	set_role(role, mask);
	if (role == ZBC_ROLE_ZC) {
		uint8_t key[16];

		if (sreg_u32(0x02) != 0) {
			zb_set_pan_id((zb_uint16_t)sreg_u32(0x02));
		}
		if (!sreg_is_zero(0x08) && sreg_bytes(0x08, key, sizeof(key)) == 0) {
			zb_secur_setup_nwk_key(key, 0);
		}
	}
	if (epid_lsb) {
		zb_set_extended_pan_id(epid_lsb);
	}
}

static int start_network(uint8_t role, zb_uint32_t mask, const uint8_t *epid_lsb)
{
	if (stored_role != ZBC_ROLE_NONE) {
		return AT_ERR_IN_PAN;
	}
	if (stack_started) {
		return defer_to_next_boot();
	}
	prepare_new_network(role, mask, epid_lsb);
	if (role == ZBC_ROLE_ZC) {
		return run_op(OP_FORM, FORM_TIMEOUT, AT_ERR_CANNOT_FORM);
	}
	return run_op(OP_JOIN, JOIN_TIMEOUT, AT_ERR_NO_NETWORK);
}

static const uint8_t *preferred_epid(uint8_t *buf)
{
	if (sreg_is_zero(0x03) || sreg_bytes(0x03, buf, 8) != 0) {
		return NULL;
	}
	at_reverse(buf, 8);
	return buf;
}

static int cmd_en(char *args)
{
	uint8_t epid[8];

	if (*args) {
		return AT_ERR_INVALID_PARAM;
	}
	return start_network(ZBC_ROLE_ZC, channel_mask(), preferred_epid(epid));
}

static int cmd_jn(char *args)
{
	uint8_t epid[8];

	if (*args) {
		return AT_ERR_INVALID_PARAM;
	}
	return start_network(end_device_type() ? ZBC_ROLE_ZED : ZBC_ROLE_ZR, channel_mask(),
			     preferred_epid(epid));
}

/* AT+JPAN:<channel>,<PID or EPID> */
static int cmd_jpan(char *args)
{
	uint8_t epid[8];
	char *comma;
	char *end;
	long channel;
	size_t id_len;
	uint32_t pan;

	if (args[0] != ':' || !(comma = strchr(args, ','))) {
		return AT_ERR_INVALID_PARAM;
	}
	channel = strtol(args + 1, &end, 10);
	id_len = strlen(comma + 1);
	if (end != comma || channel < 11 || channel > 26) {
		return AT_ERR_INVALID_PARAM;
	}
	if (id_len == 16 && at_parse_hex_rev(comma + 1, epid, 8) == 0) {
		return start_network(end_device_type() ? ZBC_ROLE_ZED : ZBC_ROLE_ZR,
				     1UL << channel, epid);
	}
	if (id_len == 4 && at_parse_hex_n(comma + 1, 4, &pan) == 0) {
		/* The PAN ID cannot be used as a join filter: only the channel restricts. */
		return start_network(end_device_type() ? ZBC_ROLE_ZED : ZBC_ROLE_ZR,
				     1UL << channel, NULL);
	}
	return AT_ERR_INVALID_PARAM;
}

static void leave_network(enum op leave_op)
{
	if (zbc_joined()) {
		k_sem_reset(&op_done);
		op = leave_op;
		ZB_SCHEDULE_APP_CALLBACK(zb_bdb_reset_via_local_action, 0);
		if (k_sem_take(&op_done, LEAVE_TIMEOUT) != 0) {
			op = OP_NONE;
			LOG_WRN("No leave confirmation, resetting anyway");
		}
	}
	role_save(ZBC_ROLE_NONE);
}

static int cmd_dassl(char *args)
{
	if (*args) {
		return AT_ERR_INVALID_PARAM;
	}
	if (stored_role == ZBC_ROLE_NONE) {
		return AT_ERR_NOT_JOINED;
	}
	leave_network(OP_LEAVE);
	at_print_result(AT_OK);
	if (!sreg_bit(0x0E, S0E_LEFTPAN_OFF)) {
		at_print("LeftPAN");
	}
	at_reboot();
	return AT_NO_RESPONSE;
}

static int cmd_factory(char *args)
{
	if (*args) {
		return AT_ERR_INVALID_PARAM;
	}
	if (stored_role != ZBC_ROLE_NONE) {
		leave_network(OP_FACTORY);
	}
	(void)settings_delete("at/zb/pend");
	sreg_factory_reset();
	at_print_result(AT_OK);
	at_reboot();
	return AT_NO_RESPONSE;
}

static const char *role_name(void)
{
	switch (current_role()) {
	case ZBC_ROLE_ZC:
		return "COO";
	case ZBC_ROLE_ZR:
		return "FFD";
	default:
		break;
	}
	/* S0A bits F-E: 10 = ZED, 01 = SED, 11 = MED */
	if (sreg_bit(0x0A, S0A_TYPE_HIGH) && sreg_bit(0x0A, S0A_TYPE_LOW)) {
		return "MED";
	}
	return sreg_bit(0x0A, S0A_TYPE_LOW) ? "SED" : "ZED";
}

static int cmd_n(char *args)
{
	zb_ext_pan_id_t epid;
	char epid_str[17];
	int power = sreg_s8(0x01);

	if (*args && strcmp(args, "?") != 0) {
		return AT_ERR_INVALID_PARAM;
	}
	if (!zbc_joined()) {
		at_print("+N=NoPAN");
		return AT_OK;
	}
	zb_get_extended_pan_id(epid);
	at_hex_rev(epid_str, epid, sizeof(epid));
	at_print(power < 0 ? "+N=%s,%u,-%02d,%04X,%s" : "+N=%s,%u,%02d,%04X,%s", role_name(),
		 zb_get_current_channel(), power < 0 ? -power : power, zb_get_pan_id(), epid_str);
	return AT_OK;
}

const struct at_cmd zbc_cmds[] = {
	{ "+EN", cmd_en },
	{ "+JN", cmd_jn },
	{ "+JPAN", cmd_jpan },
	{ "+DASSL", cmd_dassl },
	{ "+N", cmd_n },
	{ "&F", cmd_factory },
	{ NULL, NULL },
};

void zbc_init(void)
{
	k_work_init_delayable(&reboot_work, reboot_fn);
	(void)settings_load_subtree_direct("at/zb", load_cb, NULL);

	if (pending_cmd[0] != '\0') {
		(void)settings_delete("at/zb/pend");
		at_uart_inject_line(pending_cmd);
	} else if (stored_role != ZBC_ROLE_NONE) {
		/* Rejoin the recorded network from ZBOSS NVRAM, as R309 does after a reset. */
		set_role(stored_role, channel_mask());
		stack_started = true;
		zigbee_enable();
	}
}
```

## src/zb_msg.h
```c
#ifndef ZB_MSG_H_
#define ZB_MSG_H_

#include "at.h"

/* Build endpoint 2 from S48-S4C and register endpoints and data callbacks.
 * Call before the Zigbee stack starts.
 */
void zbm_init(void);

extern const struct at_cmd zbm_cmds[];

#endif /* ZB_MSG_H_ */
```
